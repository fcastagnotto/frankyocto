## sources/meta-frank/conf/distro/xwing.conf
```bitbake
include ../qbee-key.inc

DISTRO = "xwing"
DISTRO_NAME = "Frank X-Wing"
DISTRO_VERSION = "1.0"
DISTRO_CODENAME = "X-Wing"

DISTRO_FEATURES:append = " systemd rauc usrmerge opengl"
DISTRO_FEATURES:remove = " sysvinit"

VIRTUAL-RUNTIME_init_manager = "systemd"
VIRTUAL-RUNTIME_login_manager = "shadow-base"
VIRTUAL-RUNTIME_dev_manager = "udev"

# SDIMG_ROOTFS_TYPE="ext4"
ENABLE_UART = "1"
RPI_USE_U_BOOT = "1"
PREFERRED_PROVIDER_virtual/bootloader = "u-boot"
PREFERRED_PROVIDER_virtual/kernel = "linux-raspberrypi-v7_6.12"
hostname:pn-base-files = "bb8"

IMAGE_OVERHEAD_FACTOR = "1.0"
IMAGE_ROOTFS_EXTRA_SPACE = "0"
```

## sources/meta-frank/conf/machine/raspberrypi-bb8.conf
```bitbake
DEFAULTTUNE ?= "arm1176jzfshf"

require conf/machine/include/tune-arm1176jzf-s.inc
include conf/machine/include/rpi-base.inc

SDIMG_KERNELIMAGE  ?= "kernel.img"
UBOOT_MACHINE = "rpi_config"
SERIAL_CONSOLES ?= "115200;ttyAMA0"

ARMSTUB ?= "armstub.bin"

MACHINEOVERRIDES =. "raspberrypi-bb8:"

# allinea upstream kernel
KERNEL_IMAGETYPE = "uImage"
UBOOT_ENTRYPOINT = "0x00008000"
UBOOT_LOADADDRESS = "0x00008000"
KERNEL_EXTRA_ARGS += "LOADADDR=${UBOOT_ENTRYPOINT}"

# allinea meta-raspberrypi boot logic
RPI_KERNEL_DEVICETREE = "bcm2835-rpi-b.dtb"
PREFERRED_PROVIDER_virtual/kernel = "linux-master"
RPI_USE_U_BOOT = "1"
RPI_KERNEL_DEVICETREE_OVERLAYS = ""
```
