## sources/meta-frank/conf/distro/milleniumfalcon.conf
```bitbake
include ../qbee-key.inc

DISTRO = "milleniumfalcon"
DISTRO_NAME = "Frank Millenium Falcon"
DISTRO_VERSION = "1.9"
DISTRO_CODENAME = "Millenium Falcon"

DISTRO_FEATURES:append = " systemd rauc usrmerge opengl"
DISTRO_FEATURES:remove = " sysvinit"

VIRTUAL-RUNTIME_init_manager = "systemd"
VIRTUAL-RUNTIME_login_manager = "shadow-base"
VIRTUAL-RUNTIME_dev_manager = "udev"

# SDIMG_ROOTFS_TYPE="ext4"
ENABLE_UART = "1"
RPI_USE_U_BOOT = "1"
PREFERRED_PROVIDER:virtual/bootloader = "u-boot"
hostname:pn-base-files = "bb8"

IMAGE_OVERHEAD_FACTOR = "1.0"
IMAGE_ROOTFS_EXTRA_SPACE = "0"
```

## sources/meta-frank/conf/layer.conf
```bitbake
# We have a conf and classes directory, add to BBPATH
BBPATH .= ":${LAYERDIR}"

# We have recipes-* directories, add to BBFILES
BBFILES += "${LAYERDIR}/recipes-*/*/*.bb ${LAYERDIR}/recipes-*/*/*.bbappend"

BBFILE_COLLECTIONS += "meta-frank"
BBFILE_PATTERN_meta-frank = "^${LAYERDIR}/"
BBFILE_PRIORITY_meta-frank =  "9"

# This should only be incremented on significant changes that will
# cause compatibility issues with other layers
LAYERVERSION_meta-frank = "1"

LAYERDEPENDS_meta-frank = "core"
LAYERSERIES_COMPAT_meta-frank = "scarthgap"
```
